## display/esp32-airtracker/sdkconfig.defaults
```kconfig
# ESP-IDF configuration for ESP32-C3 AirTracker display

# Basic configuration
CONFIG_IDF_TARGET_ESP32C3=y
CONFIG_IDF_TARGET="esp32c3"

# Serial/Console settings to match ESPHome
CONFIG_ESP_CONSOLE_UART_DEFAULT=y
CONFIG_ESP_CONSOLE_UART_NUM=0
CONFIG_ESP_CONSOLE_UART_BAUDRATE_115200=y

# SPI settings
CONFIG_SPI_MASTER_IN_IRAM=y
CONFIG_SPI_MASTER_ISR_IN_IRAM=y

# FreeRTOS settings
CONFIG_FREERTOS_HZ=1000

# Logging
CONFIG_LOG_DEFAULT_LEVEL_INFO=y
CONFIG_LOG_MAXIMUM_LEVEL_INFO=y

# Disable unnecessary features to save space
CONFIG_BT_ENABLED=n
CONFIG_WIFI_ENABLED=n
```

## display/esp32-idf-airtracker/sdkconfig.defaults
```kconfig
CONFIG_IDF_TARGET_ESP32C3=y
CONFIG_IDF_TARGET="esp32c3"

# Serial settings
CONFIG_ESP_CONSOLE_UART_DEFAULT=y
CONFIG_ESP_CONSOLE_UART_NUM=0
CONFIG_ESP_CONSOLE_UART_BAUDRATE_115200=y

# SPI settings
CONFIG_SPI_MASTER_IN_IRAM=y
CONFIG_SPI_MASTER_ISR_IN_IRAM=y

# FreeRTOS
CONFIG_FREERTOS_HZ=1000

# Logging
CONFIG_LOG_DEFAULT_LEVEL_INFO=y

# Disable unused
CONFIG_BT_ENABLED=n
CONFIG_WIFI_ENABLED=n
```
